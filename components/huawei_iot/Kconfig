## components/huawei_iot/Kconfig
```kconfig
menu "HUWEI IOT MQTT Configuration"

    menu "OTA Configuration"

        config HUAWEI_HARDWARE_VERSION
            string "device hardware version (设备硬件版本)"
            default "V1.0"
            help
                Please use lower case

        config HUAWEI_SOFTWARE_VERSION
            string "device software version (设备软件版本，建议不修改此项)"
            default "V1.0"
            help
                Please use lower case

    endmenu

    config HUWEI_IOT_ENABLE_MQTTS
        bool "Enable MQTTS (是否使用MQTT SSL加密连接)"
        default y
        help
            This option will enable MQTTS protocol by initializing SSL transport

   

    menu "HUWEI IOT PV Configuration"
    
        config HUWEI_IOT_PV_ENABLE
            bool "Enable PV (是否启动量产模式，具体文档查阅 docs/pv.md)"
            default n

        menu "HUWEI IOT Triples Configuration"
             visible if !HUWEI_IOT_PV_ENABLE

            config MQTT_HOST
               string "MQTT Host (MQTT连接域名)"
               default "xxxxxx.iot-mqtts.cn-north-4.myhuaweicloud.com"
               help
                  Please use lower case

            config TRIPLES_DEVICE_SN_CODE
               string "device sn code (设备标识码)"
               default "F4CFA25BB155"
               help
                   Please use lower case

            config TRIPLES_DEVICE_ID
               string "Device ID(设备ID)"
               default "aithinker_F4CFA25BB155"
               help
                   Please use lower case
        
        
            config TRIPLES_DEVICE_SECRET
               string "Device Secret(设备密钥)"
               default "Device Secret"
               help
                   Please use lower case

        endmenu

    endmenu

endmenu
```

## sdkconfig.defaults
```kconfig
CONFIG_HUAWEI_HARDWARE_VERSION="V1.0"
CONFIG_HUAWEI_SOFTWARE_VERSION="V1.0"
# end of OTA Configuration

CONFIG_HUWEI_IOT_ENABLE_MQTTS=y

#
# HUWEI IOT PV Configuration
#
# CONFIG_HUWEI_IOT_PV_ENABLE is not set

#
# HUWEI IOT Triples Configuration
#
CONFIG_MQTT_HOST="a1621cfafc.iot-mqtts.cn-north-4.myhuaweicloud.com"
CONFIG_TRIPLES_DEVICE_SN_CODE="F4CFA25BB155"
CONFIG_TRIPLES_DEVICE_ID="aithinker_F4CFA25BB155"
CONFIG_TRIPLES_DEVICE_SECRET="F4CFA25BB155"


#
# mbedTLS
#
CONFIG_MBEDTLS_INTERNAL_MEM_ALLOC=y
# CONFIG_MBEDTLS_DEFAULT_MEM_ALLOC is not set
# CONFIG_MBEDTLS_CUSTOM_MEM_ALLOC is not set
CONFIG_MBEDTLS_ASYMMETRIC_CONTENT_LEN=y
CONFIG_MBEDTLS_SSL_IN_CONTENT_LEN=16384
CONFIG_MBEDTLS_SSL_OUT_CONTENT_LEN=4096
CONFIG_MBEDTLS_DYNAMIC_BUFFER=y
CONFIG_MBEDTLS_DYNAMIC_FREE_PEER_CERT=y
CONFIG_MBEDTLS_DYNAMIC_FREE_CONFIG_DATA=y
CONFIG_MBEDTLS_DYNAMIC_FREE_CA_CERT=y
# CONFIG_MBEDTLS_DEBUG is not set


# Log output
#
# CONFIG_LOG_DEFAULT_LEVEL_NONE is not set
# CONFIG_LOG_DEFAULT_LEVEL_ERROR is not set
# CONFIG_LOG_DEFAULT_LEVEL_WARN is not set
CONFIG_LOG_DEFAULT_LEVEL_INFO=y
# CONFIG_LOG_DEFAULT_LEVEL_DEBUG is not set
# CONFIG_LOG_DEFAULT_LEVEL_VERBOSE is not set
CONFIG_LOG_DEFAULT_LEVEL=3
# CONFIG_LOG_COLORS is not set
CONFIG_LOG_TIMESTAMP_SOURCE_RTOS=y
# CONFIG_LOG_TIMESTAMP_SOURCE_SYSTEM is not set
# end of Log output
```
